/* control the link process
 * ENTRY shows the entrance function of the executable file
 */
ENTRY(loader)
/* Linux executable file */
OUTPUT_FORMAT(elf32-i386)
/* architecture */
OUTPUT_ARCH(i386:i386)

/* "." is a location counter, recording the virtual address of the current 
 * position
 */
SECTIONS
{
    . = 0x0100000;
    .text :
    {
        *(.multiboot)
        *(.text)
        /* read only data */
        *(.rodata)
    }

    .data :
    {
        _start_ctors = .;
        /* .init_array
         * global object generated by constructor in .init_array
         * use KEEP to forbid releasing the resources
         */
        KEEP(*(.init_array));
        /* SORT_BY_INIT_PRIORITY will sort sections into ascending order by 
         * numerical value of the GCC init_priority attribute encoded in the 
         * section name before placing them in the output file 
         */
        KEEP(*(SORT_BY_INIT_PRIORITY(.init_array)));
        _end_ctors = .;
        *(.data)
    }

    .bss :
    {
        *(.bss)
    }

    /DISCARD/ :
    {
        *(.fini_array)
        *(.comment)
    }
}